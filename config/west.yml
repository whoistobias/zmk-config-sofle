## config/west.yml
```yaml
manifest:
  remotes:
    - name: zmkfirmware
      url-base: https://github.com/zmkfirmware
    - name: infused-kim
      url-base: https://github.com/infused-kim
    - name: nickconway
      url-base: https://github.com/nickconway
  projects:
    # - name: zmk
    #   remote: infused-kim
    #   revision: sofle
    #   import: app/west.yml
    - name: zmk
      remote: nickconway
      revision: dev
      import: app/west.yml
  self:
    path: config
```
